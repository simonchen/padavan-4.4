&raeth {
	status = "okay";
	mac-address = [00 00 00 00 00 00];
	gmac1-support = "rgmii-1";
	rgmii-mode-1 = "force-1000";
	gmac2-support = "rgmii-2";
	rgmii-mode-2 = "force-1000";
	gmac2-phy-address = <0>;
	gmac1_txq_num = <1>;
	gmac1_txq_txd_num = <1024>;
	gmac2_txq_num = <1>;
	gmac2_txq_txd_num = <1024>;
	num_rx_desc = <1024>;
};

&hnat {
        mtketh-wan = "eth3";
        mtketh-ppd = "eth2";
        mtketh-lan = "eth2";
	ext-devices = "wlan0","wlan1","rax0","ra0", "rai0","apclii0","apclix0", "apcli0";
        mtketh-max-gmac = <2>;
        status = "okay";
};
